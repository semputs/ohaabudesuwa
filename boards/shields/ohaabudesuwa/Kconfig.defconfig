## boards/shields/ohaabudesuwa/Kconfig.defconfig
```kconfig
if SHIELD_OHAABUDESUWA

config ZMK_KEYBOARD_NAME
    default "ohaabudesuwa"

endif
```

## boards/shields/ohaabudesuwa/Kconfig.shield
```kconfig
config SHIELD_OHAABUDESUWA_LEFT
    def_bool $(shields_list_contains,ohaabudesuwa_left)

config SHIELD_OHAABUDESUWA_RIGHT
    def_bool $(shields_list_contains,ohaabudesuwa_right)
```

## config/west.yml
```yaml
manifest:
  remotes:
#    - name: zmkfirmware
#      url-base: https://github.com/zmkfirmware
    - name: urob
      url-base: https://github.com/urob

    # Additional modules containing boards/shields/custom code can be listed here as well
    # See https://docs.zephyrproject.org/3.2.0/develop/west/manifest.html#projects
#    - name: ftc
#      url-base: https://github.com/ftc
  projects:
    - name: zmk
#      remote: ftc
#      revision: mouse-ftc
      remote: urob
      revision: main-with-native-mouse
      import: app/west.yml
#      remote: zmkfirmware
#      revision: main
#      import: app/west.yml
  self:
    path: config
```
