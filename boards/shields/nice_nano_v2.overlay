&spi1 {
  compatible = "nordic,nrf-spim";
  status = "okay";
  mosi-pin = <6>; /* 6 = D1 or P0.06. 20 = D3 or P0.20 . in case it doesnt work*/
  // Unused pins, needed for SPI definition, but not used by the ws2812 driver itself.
  sck-pin = <5>;
  miso-pin = <7>;

  led_strip: ws2812@0 {
    compatible = "worldsemi,ws2812-spi";
    label = "WS2812";

    /* SPI */
    reg = <0>; /* ignored, but necessary for SPI bindings */
    spi-max-frequency = <4000000>;

    /* WS2812 */
    chain-length = <15>; /* number of LEDs << 6 each side*/
    spi-one-frame = <0x70>;
    spi-zero-frame = <0x40>;
  };
};

/ {
	chosen {
		zmk,underglow = &led_strip;
	};
};